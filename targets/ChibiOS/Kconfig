## targets/ChibiOS/Kconfig
```kconfig
#
# Copyright (c) .NET Foundation and Contributors
# See LICENSE file in the project root for full license information.
#

menu "ChibiOS Platform"
    depends on RTOS_CHIBIOS

config CHIBIOS_CONTRIB_REQUIRED
    bool "ChibiOS Community contributions repository required"
    default n

config CHIBIOS_SWO_OUTPUT
    bool "ARM Cortex-M Single Wire Output (SWO)"
    default n

config STM32_CUBE_PACKAGE_REQUIRED
    bool "STM32 Cube package required"
    default n

choice TARGET_WIFI_DRIVER
    prompt "WiFi driver"
    depends on TARGET_HAS_WIFI
    default TARGET_WIFI_DRIVER_CYW43

config TARGET_WIFI_DRIVER_CYW43
    bool "CYW43 (cyw43-driver, Pico W)"

config TARGET_WIFI_DRIVER_ISM43362
    bool "Inventek ISM43362 (eS-WiFi module with onboard TCP/IP stack)"

config TARGET_WIFI_DRIVER_WHD
    bool "Infineon WHD (Wi-Fi Host Driver, BCM43362 over SDIO)"

endchoice

endmenu
```

## targets/Nordic/Kconfig
```kconfig
#
# Copyright (c) .NET Foundation and Contributors
# See LICENSE file in the project root for full license information.
#

menu "Nordic nRF Connect SDK (Zephyr) Platform"
    depends on RTOS_NORDIC

config NORDIC_ZEPHYR_BOARD
    string "Zephyr board identifier"
    help
      Zephyr board target passed to the Zephyr build system as BOARD,
      in hardware model v2 form (board/soc/variant), e.g.
      "nrf52840dk/nrf52840" or "nrf9160dk/nrf9160/ns".

endmenu
```

## targets/Nordic/NRF52840_DK/defconfig
```kconfig
# defconfig for NRF52840_DK

CONFIG_TARGET_BOARD="NRF52840_DK"
CONFIG_TARGET_SERIES="nrf52840"
CONFIG_RTOS_NORDIC=y
# CONFIG_NF_TARGET_HAS_NANOBOOTER is not set
# CONFIG_NF_FEATURE_USE_RNG is not set
CONFIG_API_SYSTEM_DEVICE_I2C=y
CONFIG_NORDIC_ZEPHYR_BOARD="nrf52840dk/nrf52840"
```

## targets/Nordic/NRF9160_DK/defconfig
```kconfig
# defconfig for NRF9160_DK

CONFIG_TARGET_BOARD="NRF9160_DK"
CONFIG_TARGET_SERIES="nrf9160"
CONFIG_RTOS_NORDIC=y
# CONFIG_NF_TARGET_HAS_NANOBOOTER is not set
# CONFIG_NF_FEATURE_USE_RNG is not set
CONFIG_API_SYSTEM_DEVICE_I2C=y
CONFIG_NORDIC_ZEPHYR_BOARD="nrf9160dk/nrf9160/ns"
```
